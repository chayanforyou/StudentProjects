/*-------------------------------
Author: Abrar Antor.
Note: Educational perposes only.
-------------------------------*/

sbit SH at RC0_bit;   //attach shift register's (74HC595) 'SH_CP' pin.
sbit DS at RC2_bit;   //attach shift register's (74HC595) 'DS' pin.
sbit ST at RC1_bit;   //attach shift register's (74HC595) 'ST_CP' pin.

#define Colunm 24     //define total colunm.

unsigned const font[] = {
0x00, 0x00, 0x00, 0x00, 0x00, 0x00, 0x00, 0x00, 
0x00, 0x00, 0x00, 0x00, 0x00, 0x00, 0x00, 0x00, 
0x00, 0x00, 0x00, 0x00, 0x00, 0x00, 0x00, 0x00, 
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0x00, 0x00, 0x00, 0x00, 0x00, 0x00, 0x00, 0x00,
};


void main() {
unsigned int scroll, temp, index;
unsigned short refresh, col;
adcon1 = 0x07; //Convert ADC pin to I/O.
TRISA = 0x00;  //set PortA register for Output.
TRISB = 0x00;  //set PortB register for Output.
TRISC = 0x00;  //set PortC register for Output.
PORTA = 0x00;  //clear PortA pin.
PORTB = 0x00;  //clear PortB pin.
PORTC = 0x00;  //clear PortC pin.

   while(1){
   index = sizeof(font);   //get the font total number of values.
    for(scroll=0;scroll<index;scroll+=2){ //scroll right to left.
     for(refresh=0;refresh<80;refresh++){  //its use only for control scrolling speed.
     temp = 0;  //clear temp to 0. temp used to send data to second 8 bit ROW.
     SH = 1; SH = 0; DS = 1; ST = 1; ST = 0; //shifting '1'.
      for(col=0;col<=Colunm;col++){  //We used only 3 shift register.
      portb =~ font[scroll + temp];  //sending to 1st 8 bit row value from font.
      temp++;  //temp = temp + 1, if scroll = 1 and temp = 1, then font[2] = 0xC8.
      portc =~ font[scroll + temp];  //sending to second 8 bit row value from font.
      temp++; //plus 1 again.
      delay_us(20);  //some delay. (It is necessary to control LED bright in real.)
      SH = 1; SH = 0; DS = 0; ST = 1; ST = 0; //shifting '0'.
      }
     }
    }
   }
}